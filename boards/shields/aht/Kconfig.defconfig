## boards/shields/aht/Kconfig.defconfig
```kconfig
if SHIELD_AHT

# Name must be less than 16 characters long!
config ZMK_AHT
    default "aht"

endif
```

## boards/shields/aht/Kconfig.shield
```kconfig
# No whitespace after the comma or in your keyboard name!
config SHIELD_AHT
    def_bool $(shields_list_contains,aht)
```
